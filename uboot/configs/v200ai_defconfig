## uboot/configs/v200ai_defconfig
```kconfig
CONFIG_ARM=y
CONFIG_ARCH_SUNXI=y
CONFIG_DEFAULT_DEVICE_TREE="sun50i-h6-orangepi-3"
CONFIG_SPL=y
CONFIG_MACH_SUN50I_H6=y
CONFIG_SUNXI_DRAM_H6_LPDDR3=y
CONFIG_MMC_SUNXI_SLOT_EXTRA=2
CONFIG_BLUETOOTH_DT_DEVICE_FIXUP="brcm,bcm4345c5"
CONFIG_SPL_SUNXI_LED_STATUS_GPIO=356
# CONFIG_SYS_MALLOC_CLEAR_ON_INIT is not set
CONFIG_PHY_SUN50I_USB3=y
# CONFIG_USB_DWC3_GADGET is not set
# CONFIG_SPL_BOARD_INIT is not set
CONFIG_MMC_WRITE=y
# CONFIG_SPL_MMC_WRITE is not set
CONFIG_CC_OPTIMIZE_FOR_SIZE=y
# CONFIG_SPL_FIT is not set
# CONFIG_SPL_LOAD_FIT is not set
# CONFIG_SPL_OF_LIBFDT is not set
# CONFIG_SPL_HASH is not set
CONFIG_SPL_CYCLIC=y
CONFIG_SPL_SUNXI_LED_STATUS=y
CONFIG_SPL_SUNXI_LED_STATUS_GPIO=356
CONFIG_SPL_SUNXI_LED_STATUS_ACTIVE_HIGH=y
CONFIG_SPL_SERIAL=y
CONFIG_SPL_BANNER_PRINT=y
CONFIG_CMD_USB_MASS_STORAGE=y
CONFIG_USB_MUSB_GADGET=y
CONFIG_USB_GADGET_DOWNLOAD=y
CONFIG_USB_FUNCTION_ACM=y
CONFIG_USB_GADGET_PRODUCT_NUM=0x1011
CONFIG_BOOTCOMMAND="ums 0 mmc 1"
# CONFIG_USB_DWC3 is not set
# CONFIG_USB_XHCI_DWC3 is not set
# CONFIG_USB_XHCI_HCD is not set
# CONFIG_USB_EHCI_HCD is not set
# CONFIG_USB_OHCI_HCD is not set
# CONFIG_H6_FEL_MMC_HOOK is not set
CONFIG_SYS_MMC_MAX_BLK_COUNT=65535
CONFIG_SPL_PRINTF=y
CONFIG_ENV_IS_IN_FAT=y
CONFIG_ENV_FAT_INTERFACE="mmc"
CONFIG_ENV_FAT_DEVICE_AND_PART="1:1"
CONFIG_ENV_FAT_FILE="uboot.env"
CONFIG_ENV_SIZE=0x10000
```
